/dts-v1/;
/include/ "zynq-mini-itx.dtsi"

/ {
	axi_pcie_0: axi-pcie@50000000 {
       #address-cells = <3>;
       #size-cells = <2>;
       #interrupt-cells = <1>;
       compatible = "xlnx,axi-pcie-host-1.00.a";
       reg = < 0x50000000 0x10000000 >;
       device_type = "pci";
       interrupts = < 0 59 4 >;
       interrupt-map-mask = <0 0 0 7>;
       interrupt-map = <0 0 0 1 &pcie_intc 1>,
               <0 0 0 2 &pcie_intc 2>,
               <0 0 0 3 &pcie_intc 3>,
               <0 0 0 4 &pcie_intc 4>;
       ranges = < 0x02000000 0 0x60000000 0x60000000 0 0x10000000 >;

       pcie_intc: interrupt-controller {
           interrupt-controller;
           #address-cells = <0>;
           #interrupt-cells = <1>;
		};
	} ;
};
