## arch/arm/mach-zynq/Kconfig
```kconfig
config ARCH_ZYNQ
	bool "Xilinx Zynq ARM Cortex A9 Platform" if ARCH_MULTI_V7
	select ARCH_HAS_CPUFREQ
	select ARCH_HAS_OPP
	select ARCH_REQUIRE_GPIOLIB
	select ARCH_SUPPORTS_BIG_ENDIAN
	select ARM_AMBA
	select ARM_GIC
	select ARM_GLOBAL_TIMER if !CPU_FREQ
	select CACHE_L2X0
	select CADENCE_TTC_TIMER
	select GENERIC_ALLOCATOR
	select GENERIC_CLOCKEVENTS
	select HAVE_ARM_SCU if SMP
	select HAVE_ARM_TWD if SMP
	select HAVE_SMP
	select ICST
	select MFD_SYSCON
	select SOC_BUS
	select MIGHT_HAVE_CACHE_L2X0
	select MIGHT_HAVE_PCI
	help
	  Support for Xilinx Zynq ARM Cortex A9 Platform

if ARCH_ZYNQ

menu "Xilinx Specific Options"

config XILINX_PREFETCH
	bool "Cache Prefetch"
	default y
	help
	  This option turns on L1 & L2 cache prefetching to get the best performance
	  in many cases. This may not always be the best performance depending on
	  the usage.

endmenu

endif
```

## arch/mips/cavium-octeon/Kconfig
```kconfig
if CPU_CAVIUM_OCTEON

config CAVIUM_OCTEON2
	bool "Build the kernel to be used only on OCTEON II or OCTEON III processor cores"
	default "n"
	help
	  This option enables the generation of Octeon2 specific
	  instructions by the compiler, resulting in a kernel that is
	  more efficient, but that will not run on Octeon and
	  OcteonPlus processor cores.

config CAVIUM_CN63XXP1
	bool "Enable CN6XXX DCache prefetch errata workaround"
	default "n"
	help
	  The CN63XXP1 chip require build time workarounds to
	  function reliably, select this option to enable them.  These
	  workarounds will cause a slight decrease in performance on
	  non-CN6XXX hardware.

config CAVIUM_OCTEON_EXTRA_CVMSEG
	int "Number of extra L1 cache lines reserved for CVMSEG memory"
	range 0 50
	default 0
	help
	  CVMSEG LM is a segment that accesses portions of the dcache
	  as a local memory; the larger CVMSEG is, the smaller the
	  cache is.  The kernel uses two or three blocks (one for TLB
	  exception handlers, one for driver IOBDMA operations, and on
	  models that need it, one for LMTDMA operations). This
	  selects an optional extra number of CVMSEG lines for use by
	  other software.

	  Normally no extra lines are required, and this parameter
	  should be set to zero.

endif # CPU_CAVIUM_OCTEON

if CAVIUM_OCTEON_SOC

config CAVIUM_OCTEON_EXTRA_CVMSEG
	int "Number of extra L1 cache lines reserved for CVMSEG memory"
	range 0 50
	default 0
	help
	 CVMSEG LM is a segment that accesses portions of the dcache
	 as a local memory; the larger CVMSEG is, the smaller the
	 cache is.  The kernel uses two or three blocks (one for TLB
	 exception handlers, one for driver IOBDMA operations, and on
	 models that need it, one for LMTDMA operations). This
	 selects an optional extra number of CVMSEG lines for use by
	 other software.

	 Normally no extra lines are required, and this parameter
	 should be set to zero.

config FAST_ACCESS_TO_THREAD_POINTER
	bool "Enable fast access to the thread pointer"
	default "y"
	help
	  For Mips, normally the TLS thread pointer is accessed by the
	  userspace program executing a "rdhwr" from register $29. This
	  register does not exist, so the kernel emulates the instruction
	  assigning the thread pointer to the value register. This option
	  supplies an alternate, faster access to the thread pointer. A
	  side effect of this option is that the highest 8 bytes of CVMSEG
	  is used by the kernel to save and restore the thread pointer during
	  the TLB fault handlers. This CVMSEG address is not available to user
	  applications.

config CAVIUM_OCTEON_LOCK_L2
	bool "Lock often used kernel code in the L2"
	default "y"
	help
	  Enable locking parts of the kernel into the L2 cache.

config CAVIUM_OCTEON_LOCK_L2_TLB
	bool "Lock the TLB handler in L2"
	depends on CAVIUM_OCTEON_LOCK_L2
	default "y"
	help
	  Lock the low level TLB fast path into L2.

config CAVIUM_OCTEON_LOCK_L2_EXCEPTION
	bool "Lock the exception handler in L2"
	depends on CAVIUM_OCTEON_LOCK_L2
	default "y"
	help
	  Lock the low level exception handler into L2.

config CAVIUM_OCTEON_LOCK_L2_LOW_LEVEL_INTERRUPT
	bool "Lock the interrupt handler in L2"
	depends on CAVIUM_OCTEON_LOCK_L2
	default "y"
	help
	  Lock the low level interrupt handler into L2.

config CAVIUM_OCTEON_LOCK_L2_INTERRUPT
	bool "Lock the 2nd level interrupt handler in L2"
	depends on CAVIUM_OCTEON_LOCK_L2
	default "y"
	help
	  Lock the 2nd level interrupt handler in L2.

config CAVIUM_OCTEON_LOCK_L2_MEMCPY
	bool "Lock memcpy() in L2"
	depends on CAVIUM_OCTEON_LOCK_L2
	default "y"
	help
	  Lock the kernel's implementation of memcpy() into L2.

config CAVIUM_OCTEON_PERF
	bool "OCTEON-specific hardware performance counters"
	default y
	depends on PERF_EVENTS
	help
	  support extra performance counters, including L2 cache & DRAM controller

config IOMMU_HELPER
	bool

config NEED_SG_DMA_LENGTH
	bool

config SWIOTLB
	def_bool y
	select IOMMU_HELPER
	select NEED_SG_DMA_LENGTH


config OCTEON_ILM
	tristate "Module to measure interrupt latency using Octeon CIU Timer"
	help
	  This driver is a module to measure interrupt latency using the
	  the CIU Timers on Octeon.

	  To compile this driver as a module, choose M here.  The module
	  will be called octeon-ilm

endif # CAVIUM_OCTEON_SOC
```
